## boards/shields/xiao_tp/Kconfig.defconfig
```kconfig
if SHIELD_XIAO_TP

config ZMK_KEYBOARD_NAME
    default "XIAO TrackPoint"

# TrackPoint-only device - not a split keyboard
config ZMK_SPLIT
    default n

endif # SHIELD_XIAO_TP
```

## boards/shields/xiao_tp/Kconfig.shield
```kconfig
# Copyright (c) 2020 Pete Johanson
# SPDX-License-Identifier: MIT

config SHIELD_XIAO_TP
    def_bool $(shields_list_contains,xiao_tp)
```

## config/boards/shields/xiao_tp/Kconfig.shield
```kconfig
# Register the custom shield so -DSHIELD=xiao_tp is valid
config SHIELD_XIAO_TP
    def_bool $(shields_list_contains,xiao_tp)
```
