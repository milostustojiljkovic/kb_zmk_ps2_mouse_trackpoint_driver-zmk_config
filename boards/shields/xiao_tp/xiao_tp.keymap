#include <behaviors.dtsi>
#include <dt-bindings/zmk/keys.h>
#include <dt-bindings/zmk/mouse.h>
#include <behaviors/mouse_keys.dtsi>

#define BASE 0
#define MOUSE_TP 1

#define HAS_MOUSE_TP

#ifdef HAS_MOUSE_TP
  // We store the trackpoint settings in a separate file
  // to make organization a little easier.
  #include "../../config/include/mouse_tp.dtsi"
#endif  // HAS_MOUSE_TP

/ {
    keymap {
        compatible = "zmk,keymap";
        default_layer {
            display-name = "Base";
            bindings = <
                &kp A
            >;
        };
        // Automatically activated when the mouse or trackpoint moves.
        // Configured in `include/mouse_tp.dtsi`.
        MouseTP_layer {
            display-name = "TP";
            bindings = <
                &mkp LCLK
            >;
        };
    };
};