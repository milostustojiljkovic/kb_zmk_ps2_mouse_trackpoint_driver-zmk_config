/*
 * XIAO TrackPoint Only Shield
 * Minimal device tree for TrackPoint-only device
 */

#include <dt-bindings/zmk/matrix_transform.h>

/ {
    chosen {
        // TrackPoint-only device - minimal matrix for ZMK compatibility
        zmk,kscan = &kscan0;
        zmk,matrix-transform = &default_transform;
    };

    default_transform: keymap_transform_0 {
        compatible = "zmk,matrix-transform";
        columns = <1>;
        rows = <1>;
        // Single key for TrackPoint-only device
        map = <
            RC(0,0)
        >;
    };

    kscan0: kscan {
        compatible = "zmk,kscan-gpio-matrix";
        wakeup-source;
        diode-direction = "col2row";
        // Minimal matrix - single key on D5 (P0.05) - D4 reserved for TrackPoint RESET
        row-gpios = <&gpio0 5 (GPIO_ACTIVE_HIGH | GPIO_PULL_DOWN)>;
        col-gpios = <&gpio0 6 (GPIO_ACTIVE_HIGH | GPIO_PULL_DOWN)>;
    };
};
